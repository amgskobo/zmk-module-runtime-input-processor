## Kconfig
```kconfig
config ZMK_RUNTIME_INPUT_PROCESSOR
    bool "Enable runtime input processor feature"
    select ZMK_CUSTOM_SETTINGS

if ZMK_RUNTIME_INPUT_PROCESSOR

DT_COMPAT_ZMK_RUNTIME_INPUT_PIPELINE := zmk,runtime-input-pipeline

config ZMK_RUNTIME_INPUT_PROCESSOR_TEMP_OVERRIDES
    int "Simultaneously held temporary pointing configurations"
    default 8
    range 1 64
    depends on ZMK_RUNTIME_INPUT_PROCESSOR
    help
      Maximum active behavior/position pairs for temporary DPI and axis snap.
      A press beyond this capacity is refused without changing the processor.

config ZMK_RUNTIME_INPUT_PIPELINE
    bool
    default $(dt_compat_enabled,$(DT_COMPAT_ZMK_RUNTIME_INPUT_PIPELINE))
    depends on INPUT && INPUT_MODE_THREAD

if ZMK_RUNTIME_INPUT_PIPELINE

config ZMK_RUNTIME_INPUT_PIPELINE_FRAME_EVENTS
    int "Maximum source events per pipeline frame"
    default 16
    range 2 64

config ZMK_RUNTIME_INPUT_PIPELINE_OUTPUT_EVENTS
    int "Maximum events after each pipeline stage"
    default 32
    range 2 128

config ZMK_RUNTIME_INPUT_PIPELINE_QUEUE_FRAMES
    int "Queued complete pipeline frames"
    default 8
    range 1 32

config ZMK_RUNTIME_INPUT_PIPELINE_STACK_SIZE
    int "Pipeline output worker stack size"
    default 4096
    range 2048 8192

config ZMK_RUNTIME_INPUT_PIPELINE_INIT_PRIORITY
    int "Pipeline init priority after its source and processors"
    default 95

config ZMK_RUNTIME_INPUT_PIPELINE_TEST
    bool "Enable pipeline test hooks"
    depends on ARCH_POSIX
    default n

endif

DT_COMPAT_ZMK_RUNTIME_INPUT_ROTATION := zmk,runtime-input-rotation

config ZMK_RUNTIME_INPUT_ROTATION
    bool
    default $(dt_compat_enabled,$(DT_COMPAT_ZMK_RUNTIME_INPUT_ROTATION))
    depends on INPUT

if ZMK_RUNTIME_INPUT_ROTATION

config ZMK_RUNTIME_INPUT_ROTATION_FRAME_EVENTS
    int "Maximum source events per rotation frame"
    default 16
    range 2 64

config ZMK_RUNTIME_INPUT_ROTATION_QUEUE_FRAMES
    int "Queued complete rotation frames"
    default 8
    range 1 32

config ZMK_RUNTIME_INPUT_ROTATION_STACK_SIZE
    int "Rotation output worker stack size"
    default 2048
    range 1024 8192

config ZMK_RUNTIME_INPUT_ROTATION_INIT_PRIORITY
    int "Rotation source init priority after its input device"
    default 95

config ZMK_RUNTIME_INPUT_ROTATION_TEST
    bool "Enable owner rotation pipeline tests"
    depends on ARCH_POSIX
    default n

endif

config ZMK_RUNTIME_INPUT_PROCESSOR_INERTIA_WINDOW_SLICES
    int "Number of time slices in an inertia measurement window"
    range 4 254
    default 64

config ZMK_RUNTIME_INPUT_PROCESSOR_INERTIA_BUCKETS
    int "Inertia rolling buffer bucket count"
    range 6 256
    default 66
    help
      Must be at least the window slice count plus two. Each processor keeps
      five rolling buffers, so increasing this value uses more RAM.

config ZMK_RUNTIME_INPUT_PROCESSOR_INERTIA_REVERSE_EXIT_MIN
    int "Minimum reverse counts that stop inertia"
    range 1 65535
    default 3

config ZMK_RUNTIME_INPUT_PROCESSOR_INERTIA_REVERSE_EXIT_MAX
    int "Maximum reverse counts that stop inertia"
    range 1 65535
    default 12

config ZMK_RUNTIME_INPUT_PROCESSOR_STUDIO_RPC
    bool "Enable runtime input processor custom Studio RPC"
    depends on ZMK_STUDIO

config ZMK_RUNTIME_INPUT_PROCESSOR_NAME_MAX_LEN
    int "Maximum length of runtime input processor names"
    default 8

config ZMK_RUNTIME_INPUT_PROCESSOR_TEST
    bool "Enable test-only hooks for the persisted-settings boot-apply path"
    help
      Compiles in zmk_input_processor_runtime_test_apply_persisted_settings(),
      which lets a test synchronously re-run the settings boot-apply logic
      instead of waiting on the real SYS_INIT delay. Not for production use.

config ZMK_RENODE_STUDIO_UART_TRANSPORT
    bool "Studio RPC UART transport for Renode emulation testing"
    depends on ZMK_RUNTIME_INPUT_PROCESSOR_STUDIO_RPC
    select SERIAL
    select RING_BUFFER
    select UART_INTERRUPT_DRIVEN
    help
      Adds a Renode-only Studio RPC UART transport that is selected without
      a USB or BLE endpoint. This is solely for the module's hardware-free
      test build; do not enable it in firmware flashed to real hardware.

endif
```

## dts/bindings/input_processors/zmk,runtime-input-pipeline.yaml
```yaml
# Copyright (c) 2026 The ZMK Contributors
# SPDX-License-Identifier: MIT

description: |
  Complete-frame input pipeline. Runs processors in declaration order, expanding
  each runtime processor's rotation at that stage. Attach exactly one final ZMK
  input listener to this device. Put HID-boundary processors such as shared
  Inertia in that listener, after the virtual pipeline.

compatible: "zmk,runtime-input-pipeline"
include: base.yaml
properties:
  input-device:
    type: phandle
    required: true
  input-processors:
    type: phandle-array
    required: true
```

## dts/bindings/input_processors/zmk,runtime-input-rotation.yaml
```yaml
# Copyright (c) 2026 The ZMK Contributors
# SPDX-License-Identifier: MIT

description: |
  Virtual input source for arbitrary runtime X/Y rotation. Collects a complete
  relative frame and emits the rotated pair to a listener attached to this node.
  Keep the referenced runtime processor in that listener's input-processors.

compatible: "zmk,runtime-input-rotation"
include: base.yaml
properties:
  device:
    type: phandle
    required: true
    description: Physical or split input device to receive complete frames from
  processor:
    type: phandle
    required: true
    description: Runtime processor owning the angle and one relative X/Y code pair
```
